## config/west.yml
```yaml
manifest:
  remotes:
    - name: zmkfirmware
      url-base: https://github.com/zmkfirmware
    - name: geigeigeist
      url-base: https://github.com/GEIGEIGEIST
  projects:
    - name: zmk
      remote: zmkfirmware
      revision: main
      import: app/west.yml
    - name: totem
      remote: geigeigeist
      revision: main
  self:
    path: config
```
